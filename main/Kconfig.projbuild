## main/Kconfig.projbuild
```kconfig
menu "Accessory Configuration"
	config DISC_DUTY_CYCLE
	    int "Discovery Duty Cycle"
	    default 5
	    help
		Duty Cycle of discovery operations. Value must be > 0 and < 100.
		
	config WIFI_SSID
	    string "SSID of Wi-Fi network to connect to"
	    default ""
	    help
				Set this value to the SSID of your local Wi-Fi network.
				
	config WIFI_PASS
	    string "Password of Wi-Fi network to connect to"
	    default ""
	    help
				Set this value to the password of your local Wi-Fi network.

  config EXAMPLE_EXTENDED_ADV
      bool
      depends on SOC_BLE_50_SUPPORTED && BT_NIMBLE_50_FEATURE_SUPPORT
      default y if SOC_ESP_NIMBLE_CONTROLLER
      select BT_NIMBLE_EXT_ADV
      prompt "Enable Extended Adv"
      help
          Use this option to enable extended advertising in the example.
          If this option is disabled, ensure config BT_NIMBLE_EXT_ADV is
          also disabled from NimBLE stack menuconfig

  config EXAMPLE_PERIODIC_ADV_ENH
      bool
      prompt "Enable Periodic Adv Enhancements"
      depends on SOC_BLE_50_SUPPORTED && SOC_BLE_PERIODIC_ADV_ENH_SUPPORTED
      select BT_NIMBLE_PERIODIC_ADV_ENH
      help
            Use this option to enable periodic adv enhancements
		
choice ECC_CURVE_CHOICE
        prompt "ECC Curve Choice"

config ECC_CURVE_25519
        bool "Curve25519"

config ECC_CURVE_NIST_P_256
        bool "NIST_P256"

endchoice	
	
endmenu
```
